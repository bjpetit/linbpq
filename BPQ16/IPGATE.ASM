	PAGE	62,132
;
CODE   SEGMENT PUBLIC 'CODE'

	ASSUME  CS:CODE

	PUBLIC	BPQHOSTPORT,STOPNODE,SYSTEM,REFRESH,BWFLAG,CLOSETERM,NODE

	EXTRN	IPGATEBG:NEAR,IPGATEINIT:NEAR


	ASSUME  CS:CODE,DS:IPDATA,ES:IPDATA
;
IPDATA	SEGMENT PUBLIC	'DATA'

INCLUDE	ENVIRON.ASM

NOTBPQERROR	DB	'Switch not found$'
G8BPQ		DB	'G8BPQ'

BADCONFIGMSG	DB	'Configuration file read error',0DH,0AH,'$'
CONFIGFILENAME	DB	CONFIGNAME,0
NOCONFIGMSG	DB	'Configuration file ',CONFIGNAME,' not found',0DH,0AH,'$'
;
;	BPQCFG FIRST 128 BYTES
;
CONFIGTABLE	LABEL	BYTE
;
;	CONFIGURATION DATA STRUCTURE
;
;	DEFINES LAYOUT OF CONFIG RECORD PRODUCED BY CONFIGURATION PROG
;
;	LAYOUT MUST MATCH THAT IN CONFIG.C SOURCE
;
C_NODECALL	DB	10 DUP (0)	 ; OFFSET = 0 
C_NODEALIAS	DB	10 DUP (0)	 ; OFFSET = 10
C_BBSCALL	DB	10 DUP (0)	 ; OFFSET = 20
C_BBSALIAS	DB	10 DUP (0)	 ; OFFSET = 30
;
C_OBSINIT	DW	0		 ; OFFSET = 40
C_OBSMIN	DW	0		 ; OFFSET = 42
C_NODESINTERVAL	DW	0		 ; OFFSET = 44
C_L3TIMETOLIVE	DW	0		 ; OFFSET = 46
C_L4RETRIES	DW	0		 ; OFFSET = 48
C_L4TIMEOUT	DW	0		 ; OFFSET = 50
C_BUFFERS	DW	0		 ; OFFSET = 52
C_PACLEN	DW	0		 ; OFFSET = 54
C_TRANSDELAY	DW	0		 ; OFFSET = 56
C_T3		DW	0		 ; OFFSET = 58
   		DW	0		 ; OFFSET = 60
		DW	0		 ; OFFSET = 62
C_IDLETIME	DW	0		 ; OFFSET = 64
C_EMSFLAG	DB	0		 ; OFFSET = 66
		DB	0
C_BBS		DB	0		 ; OFFSET = 68
C_NODE		DB	0		 ; OFFSET = 69
C_HOSTINTERRUPT	DB	0		 ; OFFSET = 70
C_DESQVIEW	DB	0		 ; OFFSET = 71
C_MAXLINKS	DW	0		 ; OFFSET = 72
C_MAXDESTS	DW	0
C_MAXNEIGHBOURS	DW	0
C_MAXCIRCUITS	DW	0		; 78
 
C_TNCPORTLISTO	DB	16 DUP (0)	 ; OFFSET = 80

C_IDINTERVAL	DW	0		; 96
C_XXXXXXXX	DW	0		; 98    ; SPARE (WAS DIGIFLAG)
C_MINQUAL	DW	0		; 100
C_HIDENODES	DB	0		; 102
C_L4DELAY	DW	0		; 103
C_L4WINDOW	DW	0		; 105
C_BTINTERVAL	DW	0		; 106
X_UNPROTO	DB	9 DUP (0)	; 108	; NOW SPARE
C_BBSQUAL	DW	0		; 117
		DB	(CONFIGTABLE+128-$) DUP (0)



CONFIGHANDLE	DW	0

PORT		DB	65

TEN		DB	10
NEWVALUE	DW	0
WORD10		DW	10
WORD16		DW	16

AX25CALL	DB	7 DUP (0)
MYCALL		DB	7 DUP (0)

IPDATA	ENDS


SYSTEM		DB	'I'		; SUBSYSTEM OWNING DISPLAY - TERM OR IPGATE
REFRESH		DB	0
BWFLAG		DB	0

CLOSETERM:

	RET				; DUMMY ROUTINE

START:

	MOV	AX,IPDATA
	MOV	DS,AX

	PUSH	ES

	MOV	ES,AX

	CALL	INIT

	POP	ES

	MOV	AL,ES:5DH		; 2ND PARAM
	MOV	BWFLAG,AL

	MOV	SI,OFFSET MYCALL
	CALL	IPGATEINIT

BG:

	MOV	CS:SYSTEM,'I'
	CALL	IPGATEBG
;
	MOV	AX,1000H
	INT	15H			; FOR DESQVIEW

	STI				; FOR IBM XT BIOS BUG

	MOV	AX,1680H
	INT	2FH			; WINDOWS RELEASE TIMESLICE

	JMP	BG


STOPNODE:

	MOV	AH,4CH
	INT	21H
;
GETVALUE:
;
;	EXTRACT NUMBER (HEX OR DECIMAL) FROM INPUT STRING
;
	MOV	NEWVALUE,0

	MOV	AL,ES:[SI]
	CMP	AL,'$'			; HEX?
	JE	DECODEHEX

VALLOOP:

	MOV	AL,ES:[SI]
	CMP	AL,' '
	JBE	ENDVALUE
;
;	ANOTHER DIGIT - MULTIPLY BY 10
;
	MOV	AX,NEWVALUE
	MUL	WORD10
	MOV	NEWVALUE,AX

	MOV	AL,ES:[SI]
	INC	SI
	SUB	al,'0'
	JC	DUFFVALUE
	CMP	AL,10
	JNC	DUFFVALUE

	MOV	AH,0
	ADD	NEWVALUE,AX

	JC	DUFFVALUE
	JMP	VALLOOP

DECODEHEX:

	INC	SI

HEXLOOP:

	MOV	AL,ES:[SI]
	CMP	AL,' '
	JBE	ENDVALUE
;
;	ANOTHER DIGIT - MULTIPLY BY 16
;
	MOV	AX,NEWVALUE
	MUL	WORD16
	MOV	NEWVALUE,AX

	MOV	AL,ES:[SI]
	CMP	AL,'Z'
	JBE	CHAROK

	SUB	AL,20H			; TO LC

CHAROK:

	INC	SI
	SUB	al,'0'
	JC	DUFFVALUE
	CMP	AL,10
	JC	HEXOK
	SUB	AL,7
	CMP	AL,10
	JC	DUFFVALUE

	CMP	AL,16
	JNC	DUFFVALUE
HEXOK:
	MOV	AH,0
	ADD	NEWVALUE,AX
	JMP	HEXLOOP

ENDVALUE:
	CLC
	RET

DUFFVALUE:
	STC
	RET

NODE:
NODEINT:
	INT	7FH
	RET


BPQHOSTPORT:

	CALL	NODE

	IRET

INIT:
;
;	GET NODE INTERRUPT NUMBER FROM CONFIG FILE
;
	MOV	DX,OFFSET CONFIGFILENAME
	MOV	AH,3DH
	MOV	AL,0			; READ ONLY
	INT	21H			; OPEN IT

	JC	NOCONFIGFILE

	MOV	CONFIGHANDLE,AX

	MOV	BX,AX
	MOV	DX,OFFSET CONFIGTABLE
	MOV	CX,128
	MOV	AH,3FH

	INT	21H			; READ
	CMP	AX,CX
	JNE	SHORTCONFIG

	JMP SHORT PROCESSCONFIG

NOCONFIGFILE:

	MOV	DX,OFFSET NOCONFIGMSG
	JMP SHORT CONFIGERR

SHORTCONFIG:

	MOV	DX,OFFSET BADCONFIGMSG

CONFIGERR:

	MOV	AH,9
	INT	21H

	MOV	AX,4C01H
	INT	21H			; EXIT

PROCESSCONFIG:

	MOV	BX,CONFIGHANDLE
	MOV	AH,3EH
	INT	21H			; CLOSE IT

;	CHECK SWITCH IS LOADED
;
	PUSH	DS

	MOV	AL,C_HOSTINTERRUPT	; INTERRUPT
	MOV	BYTE PTR NODEINT+1,AL	; PATCH NODE CALL INSTRUCTION

	MOV	AH,0
	ADD	AX,AX
	ADD	AX,AX
	MOV	SI,AX

	XOR	AX,AX
	MOV	DS,AX
;
;	DS:SI POINTS TO VECTOR
;
	CMP	WORD PTR DS:2[SI],0
	POP	DS

	JE	NOSWITCH

	MOV	AH,0
	CALL	NODE

	CMP 	AX,'PB'

	JE	SWITCHOK

NOSWITCH:

	MOV	DX,OFFSET NOTBPQERROR

	MOV	AH,9
	INT	21H

	mov	AX,4c01h
	INT	21H

SWITCHOK:

	MOV     SI,OFFSET C_NODECALL
	CALL    CONVTOAX25

	MOV     SI,OFFSET AX25CALL
	MOV     DI,OFFSET MYCALL
	MOV     CX,7
	REP MOVSB
;
	RET
;

CONVTOAX25:
;
;       CONVERT CALLSIGN IN [SI] TO AX25 FORMAT IN AX25CALL
;       RETURN NZ IF CALLSIGN INVALID
;
	MOV     DI,OFFSET AX25CALL
	MOV     CX,6                    ; MAX ALPHANUMERICS
	MOV     AL,40H
	REP STOSB                       ; CLEAR IN CASE SHORT CALL
	MOV     AL,01100000B            ; DEFAULT SSID
	STOSB
	MOV     DI,OFFSET AX25CALL
	MOV     CL,7
CONVAX00:
	LODSB
	CMP     AL,'-'
	JE      CONVAX20                ; SSID FOLLOWS
	CMP     AL,' '
	JE      CONVAX40                ; END OF NAME
;
	CMP     AL,'#'
	JNE     NOTHASH

	CMP     CL,7
	JE      CONVAX10                ; OK AS FIRST CHAR
NOTHASH:
	CMP     AL,'/'                  ; ALLOW / AND DIGITS (FOR W0RLI!)
	JB      CONVAX49                ; INVALID
	CMP     AL,'9'
	JBE     CONVAX10                ; OK

	CMP     AL,'A'
	JB      CONVAX49                ; INVALID
	CMP     AL,'Z'
	JBE     CONVAX10                ; OK


	CMP     AL,'a'
	JB      CONVAX10                ; OK
	CMP     AL,'z'
	JA      CONVAX49                ; INVALID

	AND     AL,NOT 20H              ; CONVERT TO UPPER CASE
CONVAX10:
	SAL     AL,1                    ; SHIFT UP
	STOSB
	LOOP    CONVAX00
;
;       HAVE PROCESSED 7 CHARS - NAME IS INVALID
;
	JMP SHORT CONVAX49

CONVAX20:
	LODSB                           ; FIRST CHAR IF SSID
	CMP     AL,'0'
	JB      CONVAX49                ; INVALID
	CMP     AL,'9'
	JA      CONVAX49                ; OK
;
	MOV     AH,AL                   ; SAVE
	LODSB
	CMP     AL,' '
	JE      CONVAX30                ; END OF SSID

	INC     SI                      ; OTHER CODE EXPECTS SI TO POINT TO NEXT FIELD
	CMP     AL,'0'
	JB      CONVAX49                ; INVALID
	CMP     AL,'5'                  ; LIMIT 10 - 15
	JA      CONVAX49                ; OK
;
	SUB     AL,30H
	CMP     AH,'1'
	JNE     CONVAX49                ; IF 2 DIGITS, FIRST MUST BE 1

	ADD     AL,10
	MOV     AH,AL
CONVAX30:
	SAL     AH,1                    ; UP 1 BIT
	OR      AH,01100000B            ; DEFAULT RR BITS
	MOV     AX25CALL+6,AH

CONVAX40:
;
;       NO SSID SUPPLIED
;
	XOR     AL,AL                   ; SET ZERO
	RET

CONVAX49:
	OR      AL,1                    ; SET NZ
	RET

HEXOUT:

	PUSH	AX
	PUSH	AX
	sar	al,1
	sar	al,1
	sar	al,1
	sar	al,1
	call	hexout1
	pop	ax
	call	hexout1
	POP	AX
	ret

hexout1:
	and	al,0fh
	cmp	al,10
	jl	hexout5
	add	al,7
hexout5:
	add	al,30h
	STOSB
;
	ret
;
CODE	ENDS
;               
STACK	SEGMENT	STACK 'STACK'

	DB	256 DUP (0)
;
STACK	ENDS

	END	START

